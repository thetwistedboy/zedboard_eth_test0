/ {
	amba_pl: amba_pl {
		ranges;
		compatible = "simple-bus";
		#address-cells = <1>;
		#size-cells = <1>;
		firmware-name = "design_1_wrapper.bit.bin";
		clocking0: clocking0 {
			compatible = "xlnx,fclk";
			assigned-clocks = <&clkc 15>;
			assigned-clock-rates = <100000000>;
			#clock-cells = <0>;
			clock-output-names = "fabric_clk";
			clocks = <&clkc 15>;
		};
		PmodESP32_0: PmodESP32@43c00000 {
			compatible = "xlnx,PmodESP32-1.0";
			status = "okay";
			clock-names = "s_axi_aclk";
			xlnx,ip-name = "PmodESP32";
			xlnx,pmod = "Custom";
			xlnx,edk-iptype = "PERIPHERAL";
			reg = <0x43c00000 0x10000 0x43c10000 0x10000>;
			clocks = <&clkc 15>;
			xlnx,name = "PmodESP32_0";
		};
	};
};
